/*********************************************************************************************************
* 模块名称: UltraSound.c
* 摘    要: 超声模块
* 当前版本: 1.0.0
* 作    者: SZLY(COPYRIGHT 2019 SZLY. All rights reserved.)
* 完成日期: 2019年08月01日
* 内    容: 
* 注    意: 
**********************************************************************************************************
* 取代版本: �6媚？橐牛和獠糠祷� Echo-PB0,触发IO Trig-PB1
* 作    者: 
* 完成日期: 
* 修改内容: 
* 修改文件: 
*********************************************************************************************************/

/*********************************************************************************************************
*                                              包含头文件
*********************************************************************************************************/
#include "UltraSound.h"
#include <stm32f10x_conf.h>
#include "SysTick.h"

/*********************************************************************************************************
*                                              宏定义
*********************************************************************************************************/

/*********************************************************************************************************
*                                              枚举结构体定义
*********************************************************************************************************/

/*********************************************************************************************************
*                                              内部变量
*********************************************************************************************************/
static StructUltraSound s_structDistanceProc;
static float distance=0;
static u8 i_flag=0;
/*********************************************************************************************************
*                                              内部函数声明
*********************************************************************************************************/
static  void  ConfigUltraSoundGPIO(void); //配置Ultrasonic的GPIO

/*********************************************************************************************************
*                                              内部函数实现
*********************************************************************************************************/
/*********************************************************************************************************
* 函数名称: ConfigUltraSoundGPIO
* 函数功能: 配置Ultrasonic的GPIO
* 输入参数: void 
* 输出参数: void
* 返 回 值: void
* 创建日期: 2019年08月01日
* 注    意: 该模块引脚：外部返回 Echo-PB1,触发IO Trig-PB0
*********************************************************************************************************/
static  void  ConfigUltraSoundGPIO(void)
{
  GPIO_InitTypeDef GPIO_InitStructure;                  //GPIO_InitStructure用于存放GPIO的参数

  RCC_APB2PeriphClockCmd(RCC_APB2Periph_GPIOB, ENABLE); //使能GPIOB时钟

  //Echo-PB1
  GPIO_InitStructure.GPIO_Pin   = GPIO_Pin_0;           //设置引脚
  GPIO_InitStructure.GPIO_Mode  = GPIO_Mode_IPD;        //设置I/O输出速度
  GPIO_Init(GPIOB, &GPIO_InitStructure);                //设置输出类型
  GPIO_ResetBits(GPIOB, GPIO_Pin_0);                    //根据参数初始化GPIO
                                                        
  //Trig
  GPIO_InitStructure.GPIO_Pin   = GPIO_Pin_1;           //设置引脚
  GPIO_InitStructure.GPIO_Speed = GPIO_Speed_2MHz;      //设置I/O输出速度
  GPIO_InitStructure.GPIO_Mode  = GPIO_Mode_Out_PP;     //设置输出类型
  GPIO_Init(GPIOB, &GPIO_InitStructure);                //根据参数初始化GPIO   				// 初始化NVIC
}


/*********************************************************************************************************
*                                              API函数实现
*********************************************************************************************************/
/*********************************************************************************************************
* 函数名称: InitUltraSound
* 函数功能: 初始化超声模块
* 输入参数: void
* 输出参数: void
* 返 回 值: void
* 创建日期: 2019年08月01日
* 注    意: 
*********************************************************************************************************/
void InitUltraSound(void)
{

  ConfigUltraSoundGPIO();
  TIM_Cmd(TIM3, ENABLE);
  s_structDistanceProc.sta = 0;
  s_structDistanceProc.val = 0;

  GPIO_ResetBits(GPIOB, GPIO_Pin_1);   //触发IO Trig置低电平
}

/*********************************************************************************************************
* 函数名称: MeasuresDistance
* 函数功能: 开启超声测距
* 输入参数: void
* 输出参数: void
* 返 回 值: void
* 创建日期: 2019年08月01日
* 注    意: 超声测的距离单位是cm
*********************************************************************************************************/
void MeasureDistance(void)
{
  GPIO_SetBits(GPIOB, GPIO_Pin_1);
  DelayNus(15);
  GPIO_ResetBits(GPIOB, GPIO_Pin_1);
}

/*********************************************************************************************************
* 函数名称: GetUltraSoundFlg
* 函数功能: 获取超声结构体地址
* 输入参数: void
* 输出参数: void
* 返 回 值: void
* 创建日期: 2019年08月01日
* 注    意: 超声测的距离单位是cm
*********************************************************************************************************/
StructUltraSound *GetUltraSoundFlg(void)
{
  return &s_structDistanceProc;
}

/*********************************************************************************************************
* 函数名称: GetDistance
* 函数功能: 开启一次超声测距，并返回结果
* 输入参数: void
* 输出参数: void
* 返 回 值: carFlag->distance，超声测距结果
* 创建日期: 2019年08月01日
* 注    意: 超声测的距离单位是cm
*********************************************************************************************************/
u8 Readi_flag2(void){
  return i_flag;
}


void seti_flag2(u8 th){
  i_flag=th;
}


u8 GetDistance(void)
{
  u8 i = 0;
  MeasureDistance();                                         //开启一次超声测距

  //等待超声测距结果
  while ((0 == (s_structDistanceProc.sta & 0x80)) && i < 35) //最多35ms等待
  {
    i++;
    DelayNms(1);
  }
  i_flag=1;
  return (int)distance;                                  //返回超声测试结果
}



void TIM3_IRQHandler(void)
{
 
  if(TIM_GetITStatus(TIM3, TIM_IT_Update) != RESET)       //更新中断
  {
    if(0 == (s_structDistanceProc.sta&0X80))	                    //还未成功捕获
    {
      if(s_structDistanceProc.sta & 0x40)	                        //已经捕获到高电平了
      {
        if(0x3F == (s_structDistanceProc.sta & 0x3F))             //计时器存储已达最大值
        {
          s_structDistanceProc.sta |= 0x80;                       //强制接收完成
          s_structDistanceProc.val = 0xFFFF;                      //输入捕获值设为最大值
          
          //计算超声测距结果
          distance = (s_structDistanceProc.sta & 0X3F) * 65536 + s_structDistanceProc.val;
          distance = (float)distance * 170.0 / 10000.0;
          s_structDistanceProc.sta = 0;			                      //开启下一次捕获
          s_structDistanceProc.val = 0;
        }
        else
        {
          s_structDistanceProc.sta++;                             //计时器自增
        }
      }
    }
    TIM_ClearITPendingBit(TIM3, TIM_IT_Update);           //清除中断标志位
  }

  if (TIM_GetITStatus(TIM3, TIM_IT_CC3) != RESET)         //发生捕获事件
  {

    if (s_structDistanceProc.sta & 0x40)                          //捕捉到一个下降沿
    {
      s_structDistanceProc.sta |= 0x80;                           //输入捕获接收完成
      s_structDistanceProc.val = TIM_GetCapture3(TIM3);           //获取输入捕获值
      TIM_OC3PolarityConfig(TIM3, TIM_ICPolarity_Rising); //设置为上升沿捕获
      
      //计算超声测距结果
      distance = (s_structDistanceProc.sta & 0X3F) * 65536 + s_structDistanceProc.val;
      distance = (float)distance * 170.0 / 10000.0;
      s_structDistanceProc.sta = 0;			                          //开启下一次捕获
      s_structDistanceProc.val = 0;
    }
    else                                                  //第一次捕获上升沿
    {
      s_structDistanceProc.sta = 0;                               //清空输入捕获标志
      s_structDistanceProc.val = 0;                               //清空输入捕获值
      TIM_SetCounter(TIM3, 0);                            //设置TIM3的CNT为0
      s_structDistanceProc.sta |= 0x40;                           //标记捕获到了上升沿
      TIM_OC3PolarityConfig(TIM3, TIM_ICPolarity_Falling);//设置为下降沿捕获
    }

    TIM_ClearITPendingBit(TIM3, TIM_IT_CC3);
  }
}
